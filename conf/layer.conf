## conf/layer.conf
```bitbake
# We have a conf and classes directory, add to BBPATH
BBPATH .= ":${LAYERDIR}"

# We have recipes-* directories, add to BBFILES
BBFILES += "${LAYERDIR}/recipes-*/*/*.bb \
            ${LAYERDIR}/recipes-*/*/*.bbappend"

BBFILE_COLLECTIONS += "meta-essa-mx6sx"
BBFILE_PATTERN_meta-essa-mx6sx = "^${LAYERDIR}/"

BBFILE_PRIORITY_meta-essa-mx6sx = "13"

# NOTE: IMAGE_INSTALL += is not working for some weird reason,
#       use IMAGE_INSTALL_append

# userspace packages for dm-crypt
# Don't use += (creates weird issues) and use _append =
IMAGE_INSTALL:append = " libgcc"
IMAGE_INSTALL:append = " udev"
IMAGE_INSTALL:append = " lvm2"
# Install mke2fs for creating ext4 filesystems
IMAGE_INSTALL:append = " e2fsprogs-mke2fs"
IMAGE_INSTALL:append = " coreutils"
IMAGE_INSTALL:append = " keyutils"
IMAGE_INSTALL:append = " util-linux"
IMAGE_INSTALL:append = " cryptodev-module"
# userspace packages for dm-crypt
IMAGE_INSTALL:append = " cryptsetup"
# Adding init script for cryptsetup
IMAGE_INSTALL:append = " sys-setup"
IMAGE_INSTALL:append = " caam-keygen"

# Adding ZModem utility
IMAGE_INSTALL:append = " lrzsz"
# Adding SSH server for network debugging
IMAGE_INSTALL:append = " packagegroup-core-ssh-openssh"

# Changing the WKS file basaed on ESSA_BOOT_MEDIUM to add DM partition
# U-Boot will be removed from the .wic image for QSPI flash
WKS_FILE = "${@bb.utils.contains('ESSA_BOOT_MEDIUM', 'QSPI', 'essa-qspi-boot-dm.wks.in', 'essa-bootpart-dm.wks.in', d)}"

LAYERDEPENDS_meta-essa-mx6sx = "core"
LAYERSERIES_COMPAT_meta-essa-mx6sx = "honister"
```
